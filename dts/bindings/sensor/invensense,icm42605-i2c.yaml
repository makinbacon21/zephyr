## dts/bindings/sensor/invensense,icm42605-i2c.yaml
```yaml
# Copyright (c) 2025 Thomas Makin
# SPDX-License-Identifier: Apache-2.0

description: ICM-42605 motion tracking device

compatible: "invensense,icm42605-i2c"

include: [i2c-device.yaml, "invensense,icm42605-common.yaml"]
```
